## boards/arm/nrf9160_pca20035/Kconfig
```kconfig
# Kconfig - nRF91 PCA20035 board configuration
#
# Copyright (c) 2019 Nordic Semiconductor ASA
#
# SPDX-License-Identifier: LicenseRef-BSD-5-Clause-Nordic

if BOARD_NRF9160_PCA20035 || BOARD_NRF9160_PCA20035NS

config BOARD_NRF52840_GPIO_RESET
        bool "Use nRF52840 PCA10090 GPIO reset pin"
	default y if BT_H4
        help
          Use a GPIO pin to reset the nRF52840 controller and let it wait
          until all bytes traveling to the H4 device have been received
          and drained, thus ensuring communication can begin correctly.

module=BOARD
module-dep=LOG
module-str=Log level for board
source "${ZEPHYR_BASE}/subsys/logging/Kconfig.template.log_config"

endif # BOARD_NRF9160_PCA20035 || BOARD_NRF9160_PCA20035NS
```
